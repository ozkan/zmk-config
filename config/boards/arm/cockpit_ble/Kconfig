## config/boards/arm/cockpit_ble/Kconfig
```kconfig
config BOARD_ENABLE_DCDC
	bool "Enable DCDC mode"
	select SOC_DCDC_NRF52X
	default y
	depends on BOARD_COCKPIT_BLE

config BOARD_NRFMICRO_CHARGER
	bool "Enable battery charger"
	default y
	depends on BOARD_COCKPIT_BLE
```

## config/boards/arm/cockpit_ble/Kconfig.board
```kconfig
# cockpit_ble board configuration

# Copyright (c) 2023 ozkan (github.com/ozkan)
# SPDX-License-Identifier: MIT

config BOARD_COCKPIT_BLE
	bool "cockpit_ble"
	depends on SOC_NRF52840_QIAA
```

## config/boards/arm/cockpit_ble/Kconfig.defconfig
```kconfig
if BOARD_COCKPIT_BLE

config BOARD
	default "cockpit_ble"

config ZMK_KEYBOARD_NAME
    default "Cockpit BLE"

config USB_DEVICE_MANUFACTURER
	default "ozkancelik.com"

if ZMK_DISPLAY

config I2C
	default y

config SSD1306
	default y

endif # ZMK_DISPLAY

if LVGL
config LV_Z_VDB_SIZE
    default 64

config LV_DPI_DEF
    default 148

config LV_Z_BITS_PER_PIXEL
    default 1

choice LV_COLOR_DEPTH
    default LV_COLOR_DEPTH_1
endchoice
endif # LVGL


if USB_DEVICE_STACK

config USB_NRFX
	default y

endif # USB_DEVICE_STACK

config BT_CTLR
	default BT

config ZMK_BLE
	default y

config ZMK_USB
	default y

endif # BOARD_COCKPIT_BLE
```

## config/boards/arm/cockpit_ble/cockpit_ble_defconfig
```kconfig
CONFIG_SOC_SERIES_NRF52X=y
CONFIG_SOC_NRF52840_QIAA=y
CONFIG_BOARD_COCKPIT_BLE=y

# Enable MPU
CONFIG_ARM_MPU=y

# enable GPIO
CONFIG_GPIO=y

CONFIG_USE_DT_CODE_PARTITION=y
CONFIG_MPU_ALLOW_FLASH_WRITE=y
CONFIG_BUILD_OUTPUT_UF2=y
CONFIG_NVS=y
CONFIG_SETTINGS_NVS=y
CONFIG_FLASH=y
CONFIG_FLASH_PAGE_LAYOUT=y
CONFIG_FLASH_MAP=y

# Enable SPI
#  CONFIG_SPI_NRFX=y
#  CONFIG_SPI=y

# Enable PINCTRL
CONFIG_PINCTRL_NRF=y
CONFIG_PINCTRL=y

# Enable the rotary encoder
CONFIG_EC11=y
CONFIG_EC11_TRIGGER_GLOBAL_THREAD=y

# Enable support to control external power output (y)
# CONFIG_ZMK_EXT_POWER=y

# Enable sleep
CONFIG_ZMK_SLEEP=y
CONFIG_ZMK_IDLE_SLEEP_TIMEOUT=1800000

# Enable 32kHz crystal
CONFIG_CLOCK_CONTROL_NRF_K32SRC_XTAL=y
CONFIG_CLOCK_CONTROL_NRF_K32SRC_30PPM=y

#CONFIG_ZMK_USB_LOGGING=y

# set TX power level
# CONFIG_BT_CTLR_TX_PWR_PLUS_8=y // Recommended if used in a metal enclosure

# Low level setting for GATT subscriptions. Set to n to work around an annoying Windows bug with battery notifications. (y)
CONFIG_BT_GATT_ENFORCE_SUBSCRIPTION=n
```
