#include <dt-bindings/led/led.h>
#include "cockpit_ble_pinctrl.dtsi"

&spi1 {
		compatible = "nordic,nrf-spim";
		status = "okay";
		//mosi-pin = <22>;
		// Unused pins, needed for SPI definition, but not used by the ws2812 driver itself.
		//sck-pin = <46>;
		//miso-pin = <44>;

		pinctrl-0 = <&spi1_default>;
		pinctrl-1 = <&spi1_sleep>;
		pinctrl-names = "default", "sleep";

		led_strip: ws2812@0 {
			compatible = "worldsemi,ws2812-spi";
			label = "WS2812";

			/* SPI */
			reg = <0>; /* ignored, but necessary for SPI bindings */
			spi-max-frequency = <4000000>;

			/* WS2812 */
			chain-length = <13>; /* arbitrary; change at will */
			spi-one-frame = <0x70>;
			spi-zero-frame = <0x40>;
			color-mapping = <LED_COLOR_ID_GREEN LED_COLOR_ID_RED LED_COLOR_ID_BLUE>;
		};
};
